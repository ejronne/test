/*
 * Copyright (c) 2020 The ZMK Contributors
 *
 * SPDX-License-Identifier: MIT
 */

#include <behaviors.dtsi>
#include <dt-bindings/zmk/keys.h>
#include <dt-bindings/zmk/bt.h>

/ {
	keymap {
		compatible = "zmk,keymap";

		default_layer {
			// WIN+SHIFT+S | MUTE/UNMUTE | WIN+SHIFT+R
			bindings = <& &C_MUTE & >;
			sensor-bindings = <&inc_dec_kp C_VOL_UP C_VOL_DN>;
			>;
		};
	};
};
